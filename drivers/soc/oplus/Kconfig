## drivers/soc/oplus/Kconfig
```kconfig
#ifdef OPLUS_FEATURE_TP_BASIC
config OPLUS_COMMON_SOFT
  bool "config oplus common software"
  help
        define this config to get project verion from sharemem.
        Maybe this value is from CDT or dynamic identify by hardware
        id.

#endif /* OPLUS_FEATURE_TP_BASIC */


#ifdef OPLUS_FEATURE_GPIO_NC
config OPLUS_GPIO_NC
  bool "config oplus gpio nc"
  help
        define this config to compile oplus_gpio.c for device register
#endif
```
